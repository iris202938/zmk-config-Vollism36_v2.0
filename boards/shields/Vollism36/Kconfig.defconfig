## boards/shields/Vollism36/Kconfig.defconfig
```kconfig
if SHIELD_VOLLISM36_L

config ZMK_KEYBOARD_NAME
    default "Vollism36"

config ZMK_SPLIT_ROLE_CENTRAL
    default y

endif

if SHIELD_VOLLISM36_L || SHIELD_VOLLISM36_R

config ZMK_SPLIT
    default y

endif
```

## boards/shields/Vollism36/Kconfig.shield
```kconfig
config SHIELD_VOLLISM36_V2.0_L
    def_bool $(shields_list_contains,Vollism36_V2.0_L)
    
config SHIELD_VOLLISM36_V2.0_R
    def_bool $(shields_list_contains,Vollism36_V2.0_R)
```

## config/west.yml
```yaml
manifest:
  remotes:
    - name: zmkfirmware
      url-base: https://github.com/zmkfirmware
    - name: Reinmuth66
      url-base: https://github.com/Reinmuth66
    - name: zettaface
      url-base: https://github.com/zettaface
  projects:
    - name: zmk
      remote: zmkfirmware
      revision: main
      import: app/west.yml
    - name: zmk-pmw3610-driver
      remote: Reinmuth66
      revision: main
    - name: zmk-rgbled-widget
      remote: iris202938
      revision: main
    - name: zmk-input-processor-keybind
      remote: zettaface
      revision: main
    - name: zmk-analog-input-driver
      remote: Reinmuth66
      revision: main
  self:
    path: config
```
