#include "Vollism36.dtsi"
#include <input/processors.dtsi>
#include <dt-bindings/zmk/input_transform.h>
#include <dt-bindings/zmk/keys.h>
#include <dt-bindings/zmk/mouse.h>
#include <dt-bindings/zmk/pointing.h>
#include <zephyr/dt-bindings/input/input-event-codes.h>
#include <input/processors/sensor_rotation.dtsi>
#include <input/processors/zmk-input-processor-keybind.dtsi>
// #include <dt-bindings/zmk/input.h>

#define QWE 0
#define NIC 1
#define LIN 2
#define NICL 3
#define CAD 4
#define WIN 5
#define LWR 6
#define LWRL 7
#define LWRW 8
#define RSE 9
#define RSEL 10
#define RSEW 11
#define ADJ 12
#define ADJL 13
#define ADJW 14
#define MOV 15
#define MOVL 16
#define MOVW 17
#define NUM 18
#define NUML 19
#define NUMW 20
#define WINS 21
#define AML 22
#define BLE 23

/ {
    aliases {
        led-red = &led0;   /* Xiao BLE の赤色LEDラベル */
        led-green = &led1; /* Xiao BLE の緑色LEDラベル */
        led-blue = &led2;  /* Xiao BLE の青色LEDラベル */
    };
};

&kscan0 {
        col-gpios
            = <&xiao_d 1 GPIO_ACTIVE_HIGH>
            , <&xiao_d 2 GPIO_ACTIVE_HIGH> 
            , <&xiao_d 3 GPIO_ACTIVE_HIGH> 
            , <&xiao_d 6 GPIO_ACTIVE_HIGH>
            , <&gpio0 10 GPIO_ACTIVE_HIGH>
            ;
};

&pinctrl {
    spi0_default: spi0_default {
        group1 {
            psels = <NRF_PSEL(SPIM_SCK, 0, 5)>,
                    <NRF_PSEL(SPIM_MOSI, 0, 4)>,
                    <NRF_PSEL(SPIM_MISO, 0, 4)>;
        };
    };

    spi0_sleep: spi0_sleep {
        group1 {
            psels = <NRF_PSEL(SPIM_SCK, 0, 5)>,
                    <NRF_PSEL(SPIM_MOSI, 0, 4)>,
                    <NRF_PSEL(SPIM_MISO, 0, 4)>;
            low-power-enable;
        };
    };
};

/ {
    input_processors {
        sensor_rotation: sensor_rotation {
            compatible = "zmk,input-processor-sensor-rotation";
            #input-processor-cells = <0>;
            rotation-angle = <100>;
            // rotation-angle = <0>;
        };

        xy_to_keys: xy_to_keys {
            compatible = "zmk,input-processor-keybind";
            #input-processor-cells = <0>;
            bindings = <&kp RIGHT>, <&kp LEFT>, <&kp UP>, <&kp DOWN>;
            threshold = <2>; // 方向キーが勝手に入る場合はしきい値を少し上げる
            mode = <1>;
            tick = <40>; // ティック間隔
			wait-ms = <0>; // 待機時間
			tap-ms = <50>; // タップ時間
        };
    };
};

    // Ctrl + A, C: コピー
	ctrl_a_c: ctrl_a_c {
		compatible = "zmk,behavior-macro";
		#binding-cells = <0>;
		bindings
			= <&macro_press &kp LCTRL>
			, <&macro_tap &kp A>, <&macro_release &kp LCTRL>
			, <&macro_tap &kp C>
			;
	};
    // Ctrl + A, V: 貼り付け
	ctrl_a_v: ctrl_a_v {
		compatible = "zmk,behavior-macro";
		#binding-cells = <0>;
		bindings
			= <&macro_press &kp LCTRL>
			, <&macro_tap &kp A>, <&macro_release &kp LCTRL>
			, <&macro_tap &kp V>
			;
	};
    // Ctrl + D, F: ツイスト線
	ctrl_d_f: ctrl_d_f {
		compatible = "zmk,behavior-macro";
		#binding-cells = <0>;
		bindings
			= <&macro_press &kp LCTRL>
			, <&macro_tap &kp D>, <&macro_release &kp LCTRL>
			, <&macro_tap &kp F>
			;
	};
    // Ctrl + D, W: 一時補助線全削除
	ctrl_d_w: ctrl_d_w {
		compatible = "zmk,behavior-macro";
		#binding-cells = <0>;
		bindings
			= <&macro_press &kp LCTRL>
			, <&macro_tap &kp D>, <&macro_release &kp LCTRL>
			, <&macro_tap &kp W>
			;
	};
    // Ctrl + F, N: 未設定
	ctrl_f_n: ctrl_f_n {
		compatible = "zmk,behavior-macro";
		#binding-cells = <0>;
		bindings
			= <&macro_press &kp LCTRL>
			, <&macro_tap &kp F>, <&macro_release &kp LCTRL>
			, <&macro_tap &kp N>
			;
	};
    // Ctrl + D, R: 接続点
	ctrl_d_r: ctrl_d_r {
		compatible = "zmk,behavior-macro";
		#binding-cells = <0>;
		bindings
			= <&macro_press &kp LCTRL>
			, <&macro_tap &kp D>, <&macro_release &kp LCTRL>
			, <&macro_tap &kp R>
			;
	};
    // Ctrl + D, N: 三相線番
	ctrl_d_n: ctrl_d_n {
		compatible = "zmk,behavior-macro";
		#binding-cells = <0>;
		bindings
			= <&macro_press &kp LCTRL>
			, <&macro_tap &kp D>, <&macro_release &kp LCTRL>
			, <&macro_tap &kp N>
			;
	};
    // Ctrl + F, R: 未設定
	ctrl_f_r: ctrl_f_r {
		compatible = "zmk,behavior-macro";
		#binding-cells = <0>;
		bindings
			= <&macro_press &kp LCTRL>
			, <&macro_tap &kp F>, <&macro_release &kp LCTRL>
			, <&macro_tap &kp R>
			;
	};
    // Ctrl + D, A: 拡大・縮小
	ctrl_d_a: ctrl_d_a {
		compatible = "zmk,behavior-macro";
		#binding-cells = <0>;
		bindings
			= <&macro_press &kp LCTRL>
			, <&macro_tap &kp D>, <&macro_release &kp LCTRL>
			, <&macro_tap &kp A>
			;
	};
    ctrl_alt_s: ctrl_alt_s { // シンボル一覧(AHK)
		compatible = "zmk,behavior-macro";
		#binding-cells = <0>;
		bindings
			= <&macro_press &kp LCTRL>
			// , <&macro_wait_time 40>
			, <&macro_press &kp LALT>
			, <&macro_tap &kp S>
			, <&macro_release &kp LALT>
			// , <&macro_wait_time 40>
			, <&macro_release &kp LCTRL>
			// , <&to WIN> // ADJWのベースレイヤー（例としてWINレイヤー）に戻る※rsewレイヤロック強制解除用
			;
	};	



behaviors {
    rrsew_right: input_right {
            compatible = "zmk,behavior-mod-morph";
            #binding-cells = <0>;
            bindings = <&kp C>, <&kp LA(END)>; // 右：複写／移動右90度回転[AHK]
            mods = <(MOD_LSFT|MOD_RSFT)>;
    };
    rrsew_left: input_left {
            compatible = "zmk,behavior-mod-morph";
            #binding-cells = <0>;
            bindings = <&kp D>, <&kp LA(HOME)>; // 左：削除／移動左90度回転[AHK]
            mods = <(MOD_LSFT|MOD_RSFT)>;
    };
    rrsew_up: input_up {
            compatible = "zmk,behavior-mod-morph";
            #binding-cells = <0>;
            bindings = <&kp A>, <&ctrl_a_c>; // 上：領域移動／コピー[ctrl+a+c]
            mods = <(MOD_LSFT|MOD_RSFT)>;// 上：領域移動
    };
    rrsew_down: input_down {
            compatible = "zmk,behavior-mod-morph";
            #binding-cells = <0>;
            bindings = <&kp Z>, <&ctrl_a_v>; // 下：属性変更／貼付け[ctrl+a+v]
            mods = <(MOD_LSFT|MOD_RSFT)>;
    };
    radjw_right: radjw_right {
            compatible = "zmk,behavior-mod-morph";
            #binding-cells = <0>;
            bindings = <&ctrl_d_f>, <&ctrl_d_w>; // 右：多相結線／渡りページ編集
            mods = <(MOD_LSFT|MOD_RSFT)>;
    };
    radjw_left: radjw_left {
            compatible = "zmk,behavior-mod-morph";
            #binding-cells = <0>;
            bindings = <&ctrl_f_n>, <&ctrl_d_r>; // 左：三相線番／リファレンス編集
            mods = <(MOD_LSFT|MOD_RSFT)>;
    };
    radjw_up: radjw_up {
            compatible = "zmk,behavior-mod-morph";
            #binding-cells = <0>;
            bindings = <&ctrl_d_n>, <&ctrl_f_r>; // 上：自動線番／R枠変更
            mods = <(MOD_LSFT|MOD_RSFT)>;// 上：領域移動
    };
    radjw_down: radjw_down {
            compatible = "zmk,behavior-mod-morph";
            #binding-cells = <0>;
            bindings = <&ctrl_d_a>, <&ctrl_alt_s>; // 下：ツイスト線／シンボル一覧[AHK]
            mods = <(MOD_LSFT|MOD_RSFT)>;
    };
};

&trackball_listener {
    status = "okay";
    device = <&trackball>;

        /* ==========================================================
        Layer 23: BLE (通常マウス)
        ========================================================== */
        l_ble {
            layers = <BLE>;
            input-processors = 
                <&sensor_rotation>,
                <&zip_xy_transform (INPUT_TRANSFORM_X_INVERT)>,
                <&zip_xy_scaler 100 100>; // スケーリング（100/100）
        };

        /* ==========================================================
        Layer 21: WINS (通常マウス)
        ========================================================== */
        l_wins {
            layers = <WINS>;
            input-processors = 
                <&sensor_rotation>,
                <&zip_xy_transform (INPUT_TRANSFORM_X_INVERT)>,
                <&zip_temp_layer AML 100000>,
                <&zip_xy_scaler 100 100>; // スケーリング（100/100）
        };

        /* ==========================================================
        Layer 20: NUMW (スクロール)
        ========================================================== */
        l_numw {
            layers = <NUMW>;
            input-processors = 
                <&sensor_rotation>,
                <&zip_xy_transform (INPUT_TRANSFORM_X_INVERT)>,
                <&zip_xy_transform (INPUT_TRANSFORM_Y_INVERT)>,
                <&zip_xy_scaler 1 30>,
                <&zip_xy_to_scroll_mapper>,
                <&zip_xy_scaler 0 1>; 
        };

        /* ==========================================================
        Layer 19: NUML (スクロール)
        ========================================================== */
        l_numl {
            layers = <NUML>;
            input-processors = 
                <&sensor_rotation>,
                <&zip_xy_transform (INPUT_TRANSFORM_X_INVERT)>,
                <&zip_xy_transform (INPUT_TRANSFORM_Y_INVERT)>,
                <&zip_xy_scaler 1 30>,
                <&zip_xy_to_scroll_mapper>,
                <&zip_xy_scaler 0 1>; 
        };

        /* ==========================================================
        Layer 18: NUM (スクロール)
        ========================================================== */
        l_num {
            layers = <NUM>;
            input-processors = 
                <&sensor_rotation>,
                <&zip_xy_transform (INPUT_TRANSFORM_X_INVERT)>,
                <&zip_xy_transform (INPUT_TRANSFORM_Y_INVERT)>,
                <&zip_xy_scaler 1 30>,
                <&zip_xy_to_scroll_mapper>,
                <&zip_xy_scaler 0 1>; 
        };

        /* ==========================================================
        Layer 17: MOVW (方向キー変換)
           ========================================================== */
        l_movw {
            layers = <MOVW>; 
            input-processors = 
                <&sensor_rotation>,
                <&zip_xy_transform (INPUT_TRANSFORM_X_INVERT)>,
                <&zip_xy_scaler 200 100>, 
                <&xy_to_keys>;
            process-next;
        };

        l_movw_prevent {
            layers = <MOVW>;
            input-processors = 
                <&zip_xy_scaler 0 1>;
        };

        /* ==========================================================
        Layer 16: MOVL (方向キー変換)
        ========================================================== */
        l_movl {
            layers = <MOVL>;
            input-processors = 
                <&sensor_rotation>,
                <&zip_xy_transform (INPUT_TRANSFORM_X_INVERT)>,
                <&zip_xy_scaler 200 100>, 
                <&xy_to_keys>;
            process-next;
        };

        l_movl_prevent {
            layers = <MOVL>;
            input-processors = 
                <&zip_xy_scaler 0 1>;
        };

        /* ==========================================================
        Layer 15: MOV (方向キー変換)
        ========================================================== */
        l_mov {
            layers = <MOV>; 
            input-processors = 
                <&sensor_rotation>, 
                <&zip_xy_transform (INPUT_TRANSFORM_X_INVERT)>,
                <&zip_xy_scaler 200 100>, 
                <&xy_to_keys>;
            process-next;
        };

        l_mov_prevent {
            layers = <MOV>;
            input-processors = 
                <&zip_xy_scaler 0 1>;
        };

        /* ==========================================================
        Layer 14: ADJW (通常マウス)
        ========================================================== */
        l_adjw {
            layers = <ADJW>;
            input-processors = 
                <&sensor_rotation>,
                <&zip_xy_transform (INPUT_TRANSFORM_X_INVERT)>,
                <&zip_xy_scaler 120 100>; // スケーリング（120/100）
        };

        /* ==========================================================
        Layer 13: ADJL (通常マウス)
        ========================================================== */
        l_adjl {
            layers = <ADJL>;
            input-processors = 
                <&sensor_rotation>,
                <&zip_xy_transform (INPUT_TRANSFORM_X_INVERT)>,
                <&zip_temp_layer AML 100000>,
                <&zip_xy_scaler 120 100>; // スケーリング（120/100）
        };

        /* ==========================================================
        Layer 12: ADJ (通常マウス)
        ========================================================== */
        l_adj {
            layers = <ADJ>;
            input-processors = 
                <&sensor_rotation>,
                <&zip_xy_transform (INPUT_TRANSFORM_X_INVERT)>,
                <&zip_temp_layer AML 100000>,
                <&zip_xy_scaler 120 100>; // スケーリング（120/100）
        };

        /* ==========================================================
        Layer 11: RSEW (スクロール)
        ========================================================== */
        l_rsew {
            layers = <RSEW>;
            input-processors = 
                <&sensor_rotation>,
                <&zip_xy_transform (INPUT_TRANSFORM_X_INVERT)>,
                <&zip_xy_transform (INPUT_TRANSFORM_Y_INVERT)>,
                <&zip_xy_scaler 1 30>,
                <&zip_xy_to_scroll_mapper>,
                <&zip_xy_scaler 0 1>; 
        };

        /* ==========================================================
        Layer 10: RSEL (スクロール)
        ========================================================== */
        l_rsel {
            layers = <RSEL>;
            input-processors = 
                <&sensor_rotation>,
                <&zip_xy_transform (INPUT_TRANSFORM_X_INVERT)>,
                <&zip_xy_transform (INPUT_TRANSFORM_Y_INVERT)>,
                <&zip_xy_scaler 1 30>,
                <&zip_xy_to_scroll_mapper>,
                <&zip_xy_scaler 0 1>; 
        };

        /* ==========================================================
        Layer 9: RSE (スクロール)
        ========================================================== */
        l_rse {
            layers = <RSE>;
            input-processors = 
                <&sensor_rotation>,
                <&zip_xy_transform (INPUT_TRANSFORM_X_INVERT)>,
                <&zip_xy_transform (INPUT_TRANSFORM_Y_INVERT)>,
                <&zip_xy_scaler 1 30>,
                <&zip_xy_to_scroll_mapper>,
                <&zip_xy_scaler 0 1>; 
        };

        /* ==========================================================
        Layer 8: LWRW (通常マウス)
        ========================================================== */
        l_lwrw {
            layers = <LWRW>;
            input-processors =
                <&sensor_rotation>,
                <&zip_xy_transform (INPUT_TRANSFORM_X_INVERT)>,
                <&zip_xy_scaler 50 100>; // スケーリング（50/100）
        };

        /* ==========================================================
        Layer 7: LWRL (通常マウス)
        ========================================================== */
        l_lwrl {
            layers = <LWRL>;
            input-processors =
                <&sensor_rotation>,
                <&zip_xy_transform (INPUT_TRANSFORM_X_INVERT)>,
                <&zip_xy_scaler 50 100>; // スケーリング（50/100）
        };

        /* ==========================================================
        Layer 6: LWR (通常マウス)
        ========================================================== */
        l_lwr {
            layers = <LWR>;
            input-processors =
                <&sensor_rotation>,
                <&zip_xy_transform (INPUT_TRANSFORM_X_INVERT)>,
                <&zip_xy_scaler 50 100>; // スケーリング（50/100）
        };

        /* ==========================================================
        Layer 5: WIN (通常マウス)
        ========================================================== */
        l_win {
            layers = <WIN>;
            input-processors = 
                <&sensor_rotation>,
                <&zip_xy_transform (INPUT_TRANSFORM_X_INVERT)>,
                <&zip_temp_layer AML 100000>,
                <&zip_xy_scaler 100 100>; // スケーリング（100/100）
        };

        /* ==========================================================
        Layer 4: CAD (通常マウス)
        ========================================================== */
        l_cad {
            layers = <CAD>;
            input-processors = 
                <&sensor_rotation>,
                <&zip_xy_transform (INPUT_TRANSFORM_X_INVERT)>,
                <&zip_temp_layer AML 100000>,
                <&zip_xy_scaler 100 100>; // スケーリング（100/100）
        };

        /* ==========================================================
        Layer 3: NICL (通常マウス)
        ========================================================== */
        l_nicl {
            layers = <NICL>;
            input-processors = 
                <&sensor_rotation>,
                <&zip_xy_transform (INPUT_TRANSFORM_X_INVERT)>,
                <&zip_temp_layer AML 100000>,
                <&zip_xy_scaler 100 100>; // スケーリング（100/100）
        };

        /* ==========================================================
        Layer 2: LIN (通常マウス)
        ========================================================== */
        l_lin {
            layers = <LIN>;
            input-processors = 
                <&sensor_rotation>,
                <&zip_xy_transform (INPUT_TRANSFORM_X_INVERT)>,
                <&zip_temp_layer AML 100000>,
                <&zip_xy_scaler 100 100>; // スケーリング（100/100）
        };

        /* ==========================================================
        Layer 1: NIC (通常マウス)
        ========================================================== */
        l_nic {
            layers = <NIC>;
            input-processors = 
                <&sensor_rotation>,
                <&zip_xy_transform (INPUT_TRANSFORM_X_INVERT)>,
                <&zip_temp_layer AML 100000>,
                <&zip_xy_scaler 120 100>; // スケーリング（120/100）
        };

        /* ==========================================================
        Layer 0: QWE (通常マウス)
        ========================================================== */
        l_qwe {
            layers = <QWE>;
            input-processors = 
                <&sensor_rotation>,
                <&zip_xy_transform (INPUT_TRANSFORM_X_INVERT)>,
                <&zip_temp_layer AML 100000>,
                <&zip_xy_scaler 120 100>; // スケーリング（120/100）
        };
    };

&spi0 {
    status = "okay";
    compatible = "nordic,nrf-spim";
    pinctrl-0 = <&spi0_default>;
    pinctrl-1 = <&spi0_sleep>;
    pinctrl-names = "default", "sleep";
    cs-gpios = <&gpio0 9 GPIO_ACTIVE_LOW>;

    trackball: trackball@0 {
        status = "okay";
        compatible = "pixart,pmw3610-alt";
        reg = <0>;
        spi-max-frequency = <2000000>;
        irq-gpios = <&xiao_d 0 (GPIO_ACTIVE_LOW | GPIO_PULL_UP)>;
        // automouse-layer = <AML>; /* 自動マウスレイヤーをAMLに設定 */
        evt-type = <INPUT_EV_REL>;
        x-input-code = <INPUT_REL_X>;
        y-input-code = <INPUT_REL_Y>;
    };
};

&zip_temp_layer {
    excluded-positions = <
        18 // RCTRL
        24 // MB1
        26 // MB2
        27 // MB3
        28 // &mt_s LALT SLASH
        31 // LCTRL SPACE
        34 // RSHFT
    >;
};

/* 右から飛んでくるアナログスティック信号用のリスナー */
/ {
    zip_keybind_keys_directionL: zip_keybind_keys_directionL {
			compatible = "zmk,input-processor-keybind";
			#input-processor-cells = <0>;
		// track_remainders;
			bindings 
                = <&kp RIGHT>
				, <&kp LEFT>
				, <&kp UP>
				, <&kp DOWN>
				;
			tick = <150>;
			wait-ms = <100>;
			tap-ms = <50>;
			mode = <1>;
	};
	zip_keybind_keys_directionM: zip_keybind_keys_directionM {
			compatible = "zmk,input-processor-keybind";
			#input-processor-cells = <0>;
		// track_remainders;
			bindings
                = <&kp RIGHT>
				, <&kp LEFT>
				, <&kp UP>
				, <&kp DOWN>
				;
			tick = <100>; // ティック間隔
			wait-ms = <5>; // 待機時間
			tap-ms = <40>; // タップ時間
	};
	zip_keybind_keys_directionH: zip_keybind_keys_directionH {
			compatible = "zmk,input-processor-keybind";
			#input-processor-cells = <0>;
		// track_remainders;
			bindings
                = <&kp RIGHT>
				, <&kp LEFT>
				, <&kp UP>
				, <&kp DOWN>
				;
			tick = <50>; // ティック間隔
			wait-ms = <0>; // 待機時間
			tap-ms = <50>; // タップ時間
	};
    zip_keybind_keys_freecad: zip_keybind_keys_freecad {
		compatible = "zmk,input-processor-keybind";
		#input-processor-cells = <0>;
		track_remainders;
		bindings
            = <&kp N3>
			, <&kp N6>
			, <&kp N2>
			, <&kp N5>
			;
		tick = <150>;
		wait-ms = <100>;
		tap-ms = <50>;
		mode = <1>;
		// threshold = <10>
		// max_threshold = <200>
		// max_pending_activations = <10>
    };

    peripheral_listener: peripheral_listener {
        compatible = "zmk,input-listener";
        device = <&trackball_split>; /* 右から転送されてくる仮想デバイスを指定 */
        
        /* ここにスティック用のレイヤー設定などを記述 */
        r_layer23 {
			layers = <BLE>; // レイヤー23がアクティブな場合
            input-processors = <&zip_xy_scaler 40 100>; // 速度を40/100に設定 (乗数40, 除数100)
		// 	input-processors = <&zip_keybind_keys_directionH>; // zip_keybind_keys_directionH を使用
		// 	process-next; // 他のプロセッサも処理を継続
		// };
		// r_layer23-prevent {
		// 	layers = <BLE>; // レイヤー23がアクティブな場合
		// 	input-processors = <&zip_xy_scaler 0 1>; // ジョイスティックの動きをゼロにスケーリング（無効化）
		};
        r_layer22 {
			layers = <AML>; // レイヤー22がアクティブな場合
            input-processors = <&zip_xy_transform (INPUT_TRANSFORM_Y_INVERT)>
							,  <&zip_xy_scaler 4 100> // スケーリング（4/100）
							,  <&zip_xy_to_scroll_mapper>; // スクロールイベントにマッピング
		// 	input-processors = <&zip_keybind_keys_freecad>; // zip_keybind_keys_freecad を使用
		// 	process-next;
		// };
		// r_layer22-prevent {
		// 	layers = <AML>; // レイヤー22がアクティブな場合
		// 	input-processors = <&zip_xy_scaler 0 1>; // ジョイスティックの動きをゼロにスケーリング（無効化）
		};
		r_layer21 {
			layers = <WINS>; // レイヤー21がアクティブな場合
			input-processors = <&zip_keybind_keys_directionH>; // zip_keybind_keys_directionH を使用
			process-next;
		};
		r_layer21-prevent {
			layers = <WINS>; // レイヤー21がアクティブな場合
			input-processors = <&zip_xy_scaler 0 1>; // ジョイスティックの動きをゼロにスケーリング（無効化）
		};
		r_layer20 {
			layers = <NUMW>; // レイヤー20がアクティブな場合
			input-processors = <&zip_keybind_keys_directionL>; // zip_keybind_keys_directionL を使用
			process-next; // 他のプロセッサも処理を継続
		};
		r_layer20-prevent {
			layers = <NUMW>; // レイヤー20がアクティブな場合
			input-processors = <&zip_xy_scaler 0 1>; // ジョイスティックの動きをゼロにスケーリング（無効化）
		};
		r_layer19 {
			layers = <NUML>; // レイヤー19がアクティブな場合
			input-processors = <&zip_keybind_keys_directionL>; // zip_keybind_keys_directionL を使用
			process-next; // 他のプロセッサも処理を継続
		};
		r_layer19-prevent {
			layers = <NUML>; // レイヤー19がアクティブな場合
			input-processors = <&zip_xy_scaler 0 1>; // ジョイスティックの動きをゼロにスケーリング（無効化）
		};
		r_layer18 {
			layers = <NUM>; // レイヤー18がアクティブな場合
			input-processors = <&zip_keybind_keys_directionL>; // zip_keybind_keys_directionL を使用
			process-next; // 他のプロセッサも処理を継続
		};
		r_layer18-prevent {
			layers = <NUM>; // レイヤー18がアクティブな場合
			input-processors = <&zip_xy_scaler 0 1>; // ジョイスティックの動きをゼロにスケーリング（無効化）
		};
		r_layer17 {
			layers = <MOVW>; // レイヤー17がアクティブな場合
			input-processors = <&zip_keybind_keys_directionM>; // zip_keybind_keys_directionM を使用
			process-next; // 他のプロセッサも処理を継続
		};
		r_layer17-prevent {
			layers = <MOVW>; // レイヤー17がアクティブな場合
			input-processors = <&zip_xy_scaler 0 1>; // ジョイスティックの動きをゼロにスケーリング（無効化）
		};
		r_layer16 {
			layers = <MOVL>; // レイヤー16がアクティブな場合
			input-processors = <&zip_keybind_keys_directionM>; // zip_keybind_keys_directionM を使用
			process-next; // 他のプロセッサも処理を継続
		};
		r_layer16-prevent {
			layers = <MOVL>; // レイヤー16がアクティブな場合
			input-processors = <&zip_xy_scaler 0 1>; // ジョイスティックの動きをゼロにスケーリング（無効化）
		};
		r_layer15 {
			layers = <MOV>; // レイヤー15がアクティブな場合
			input-processors = <&zip_keybind_keys_directionM>; // zip_keybind_keys_directionM を使用
			process-next; // 他のプロセッサも処理を継続
		};
		r_layer15-prevent {
			layers = <MOV>; // レイヤー15がアクティブな場合
			input-processors = <&zip_xy_scaler 0 1>; // ジョイスティックの動きをゼロにスケーリング（無効化）
		};
        layer14 {
			layers = <ADJW>; // レイヤー14がアクティブな場合
			input-processors = <&zip_xy_transform (0)> // 変換なし (Y軸反転を無効化)
							, <&zip_xy_scaler 80 100>; // 速度を80/100に設定 (乗数80, 除数100)
		};
		layer13 {
			layers = <ADJL>; // レイヤー13がアクティブな場合
			input-processors = <&zip_xy_transform (0)> // 変換なし (Y軸反転を無効化)
							, <&zip_xy_scaler 80 100>; // 速度を80/100に設定 (乗数80, 除数100)
		};
		r_layer12 {
			layers = <ADJ>; // レイヤー12がアクティブな場合
            input-processors = <&zip_xy_transform (0)> // 変換なし (Y軸反転を無効化)
							, <&zip_xy_scaler 80 100>; // 速度を80/100に設定 (乗数80, 除数100)
		};
        r_layer11 {
			layers = <RSEW>; // レイヤー11がアクティブな場合
            input-processors = <&zip_xy_transform (0)> // 変換なし (Y軸反転を無効化)
							,  <&zip_xy_scaler 100 100> // 速度を100/100に設定 (乗数100, 除数100)
							// ,  <&zip_temp_layer AML 100000>
                            ;
			// input-processors = <&zip_keybind_keys_directionM>; // zip_keybind_keys_directionM を使用
			// process-next; // 他のプロセッサも処理を継続
		};
		// r_layer11-prevent {
		// 	layers = <RSEW>; // レイヤー11がアクティブな場合
		// 	input-processors = <&zip_xy_scaler 0 1>; // ジョイスティックの動きをゼロにスケーリング（無効化）
		// };
		r_layer10 {
			layers = <RSEL>; // レイヤー10がアクティブな場合
            input-processors = <&zip_xy_transform (0)> // 変換なし (Y軸反転を無効化)
							,  <&zip_xy_scaler 100 100> // 速度を100/100に設定 (乗数100, 除数100)
							// ,  <&zip_temp_layer AML 100000>
                            ;
			// input-processors = <&zip_keybind_keys_directionM>; // zip_keybind_keys_directionM を使用
			// process-next; // 他のプロセッサも処理を継続
		};
		// r_layer10-prevent {
		// 	layers = <RSEL>; // レイヤー10がアクティブな場合
		// 	input-processors = <&zip_xy_scaler 0 1>; // ジョイスティックの動きをゼロにスケーリング（無効化）
		// };
		r_layer9 {
			layers = <RSE>; // レイヤー9がアクティブな場合
            input-processors = <&zip_xy_transform (0)> // 変換なし (Y軸反転を無効化)
							,  <&zip_xy_scaler 90 100> // 速度を90/100に設定 (乗数90, 除数100)
                            // ,  <&zip_temp_layer AML 100000>
                            ;
			// input-processors = <&zip_keybind_keys_directionM>; // zip_keybind_keys_directionM を使用
			// process-next; // 他のプロセッサも処理を継続
		};
		// r_layer9-prevent {
		// 	layers = <RSE>; // レイヤー9がアクティブな場合
		// 	input-processors = <&zip_xy_scaler 0 1>; // ジョイスティックの動きをゼロにスケーリング（無効化）
		// };
		r_layer8 {
			layers = <LWRW>; // レイヤー8がアクティブな場合
			input-processors = <&zip_xy_transform (INPUT_TRANSFORM_Y_INVERT)>
							,  <&zip_xy_scaler 8 100> // スケーリング（8/100）
							,  <&zip_xy_to_scroll_mapper>; // スクロールイベントにマッピング
		};
		r_layer7 {
			layers = <LWRL>; // レイヤー7がアクティブな場合
            input-processors = <&zip_xy_scaler 40 100>; // 速度を40/100に設定 (乗数40, 除数100)
			// input-processors = <&zip_xy_transform (INPUT_TRANSFORM_Y_INVERT)>
			// 				, <&zip_xy_scaler 8 100> // スケーリング（8/100）
			// 				, <&zip_xy_to_scroll_mapper>; // スクロールイベントにマッピング
		};
		r_layer6 {
			layers = <LWR>; // レイヤー6がアクティブな場合
			input-processors = <&zip_xy_transform (INPUT_TRANSFORM_Y_INVERT)>
							,  <&zip_xy_scaler 8 100> // スケーリング（8/100）
							,  <&zip_xy_to_scroll_mapper>; // スクロールイベントにマッピング
		};
		r_layer5 {
			layers = <WIN>; // レイヤー5がアクティブな場合
			input-processors = <&zip_keybind_keys_directionH>; // zip_keybind_keys_directionH を使用
			process-next;
		};
		r_layer5-prevent {
			layers = <WIN>; // レイヤー5がアクティブな場合
			input-processors = <&zip_xy_scaler 0 1>; // ジョイスティックの動きをゼロにスケーリング（無効化）
		};
		r_layer4 {
			layers = <CAD>; // レイヤー4がアクティブな場合
			input-processors = <&zip_keybind_keys_directionM>; // zip_keybind_keys_directionM を使用
			process-next;
		};
		r_layer4-prevent {
			layers = <CAD>; // レイヤー4がアクティブな場合
			input-processors = <&zip_xy_scaler 0 1>; // ジョイスティックの動きをゼロにスケーリング（無効化）
		};
		r_layer3 {
			layers = <NICL>; // レイヤー3がアクティブな場合
			input-processors = <&zip_xy_transform (INPUT_TRANSFORM_Y_INVERT)>
							, <&zip_xy_scaler 16 100> // スケーリング（16/100）
							, <&zip_xy_to_scroll_mapper>; // スクロールイベントにマッピング
		};
        r_layer2 {
			layers = <LIN>; // レイヤー2がアクティブな場合
            input-processors = <&zip_keybind_keys_directionM>; // zip_keybind_keys_directionM を使用
            process-next;
        };
        r_layer2-prevent {
			layers = <LIN>; // レイヤー2がアクティブな場合
			input-processors = <&zip_xy_scaler 0 1>; // ジョイスティックの動きをゼロにスケーリング（無効化）
		};
		r_layer1 {
			layers = <NIC>; // レイヤー1がアクティブな場合
			input-processors = <&zip_xy_transform (INPUT_TRANSFORM_Y_INVERT)>
							, <&zip_xy_scaler 8 100> // スケーリング（8/100）
							, <&zip_xy_to_scroll_mapper>; // スクロールイベントにマッピング
		};
		r_layer0 {
            layers = <QWE>;
            input-processors = <&zip_xy_transform (INPUT_TRANSFORM_Y_INVERT)>
                            , <&zip_xy_scaler 4 100> // スケーリング（4/100）
                            , <&zip_xy_to_scroll_mapper>; // スクロールイベントにマッピング
        };
    };
};